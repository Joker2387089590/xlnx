/dts-v1/;
#include "zynq-user-common.dtsi"

/ {
    compatible = "xlnx,zynq-7000", "xlnx,zynq-zc702";

    chosen {
   
		// onsole=ttyPS0,115200 earlyprintk 指定打印输出端口
	
		bootargs = "console=ttyPS0,115200 earlyprintk";
		stdout-path = "serial0:115200n8";

    };
};
